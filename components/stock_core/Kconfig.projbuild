## components/stock_core/Kconfig.projbuild
```kconfig
menu "Stock Monitor"

config STOCK_SYMBOL
    string "Fallback ticker symbol"
    default "AAPL"
    help
      Shown only when the provisioned watchlist is empty. Normally the tickers
      entered in the captive-portal setup (stored in NVS) drive the display;
      this is the default before the device has been provisioned.

config STOCK_FINNHUB_API_KEY
    string "Finnhub API key"
    default ""
    help
      Free key from https://finnhub.io. Used for quote, fundamentals and
      news. Stored per-developer in your local sdkconfig — do NOT commit a
      real key. Leave empty to disable the Finnhub-backed screens.

config STOCK_FMP_API_KEY
    string "Financial Modeling Prep (FMP) API key"
    default ""
    help
      Free key from https://financialmodelingprep.com. Powers the economic
      calendar screen (press KEY+BOOT together to open it). Stored per-developer
      in your local sdkconfig — do NOT commit a real key. Leave empty to disable
      the calendar (KEY+BOOT will show a "no FMP API key" message).

config STOCK_ECON_BASE_URL
    string "Economic calendar base URL"
    default "https://financialmodelingprep.com/stable/economic-calendar"
    help
      The calendar is fetched from <base>?from=YYYY-MM-DD&to=YYYY-MM-DD&apikey=<key>.
      Default is FMP (its calendar needs a paid plan -> free keys get HTTP 402).
      To use the bundled free investing.com proxy instead (tools/econ_proxy),
      set this to your host, e.g. http://192.168.0.10:8442/economic-calendar
      (then STOCK_FMP_API_KEY may be any non-empty placeholder; the proxy ignores it).

config STOCK_ECON_MIN_IMPACT
    int "Economic calendar: minimum importance (1=Low 2=Medium 3=High)"
    default 2
    range 1 3
    help
      The economic calendar lists only events at or above this importance. The
      400x300 panel fits ~14 rows per week; the default (2) keeps Medium + High
      so the screen stays full. Set 3 for High-only, or 1 to include everything
      (the earliest 14 are shown, with "(+N more)" when a week overflows).

config STOCK_REFRESH_SECONDS
    int "Data refresh interval (seconds)"
    default 30
    range 10 600
    help
      How often the on-screen ticker is re-fetched in the background. Keep
      >= 10s to respect free-tier API rate limits. Navigation is button-driven
      (USER = next ticker, BOOT = next view), not timed rotation.

config STOCK_TIMEZONE
    string "Home-screen timezone (POSIX TZ)"
    default "KST-9"
    help
      POSIX TZ string used to render the home-screen clock/date in local time.
      Examples: "KST-9" (Korea), "JST-9" (Japan), "EST5EDT,M3.2.0,M11.1.0"
      (US Eastern), "CET-1CEST,M3.5.0,M10.5.0/3" (Central Europe), "UTC0".

endmenu
```

## firmware/lvgl_v9_test/components/stock_core/Kconfig.projbuild
```kconfig
menu "Stock Monitor"

config STOCK_SYMBOL
    string "Ticker symbol"
    default "AAPL"
    help
      The stock ticker to display, e.g. AAPL, MSFT, TSLA, NVDA.

config STOCK_FINNHUB_API_KEY
    string "Finnhub API key"
    default ""
    help
      Free key from https://finnhub.io. Used for quote, fundamentals and
      news. Stored per-developer in your local sdkconfig — do NOT commit a
      real key. Leave empty to disable the Finnhub-backed screens.

config STOCK_WIFI_SSID
    string "WiFi SSID"
    default ""
    help
      2.4GHz network the board joins on boot. (WiFi provisioning is left for
      you to customize; this is a simple Kconfig-driven station connect.)

config STOCK_WIFI_PASSWORD
    string "WiFi password"
    default ""

config STOCK_ROTATE_SECONDS
    int "Screen rotate interval (seconds)"
    default 3
    range 1 60
    help
      How often the bottom area cycles chart -> news -> metrics.

config STOCK_REFRESH_SECONDS
    int "Data refresh interval (seconds)"
    default 30
    range 10 600
    help
      How often data is re-fetched. Keep >= 10s to respect free-tier API
      rate limits; the screen still rotates every ROTATE_SECONDS from cache.

endmenu
```
